## meta-master/conf/layer.conf
```bitbake
# We have a conf and classes directory, add to BBPATH
BBPATH .= ":${LAYERDIR}"

# We have recipes-* directories, add to BBFILES
BBFILES += "${LAYERDIR}/recipes-*/*/*.bb \
            ${LAYERDIR}/recipes-*/*/*.bbappend"

BBFILE_COLLECTIONS += "meta-master"
BBFILE_PATTERN_meta-master = "^${LAYERDIR}/"
BBFILE_PRIORITY_meta-master = "6"

LAYERDEPENDS_meta-master = "core"
LAYERSERIES_COMPAT_meta-master = "hardknott"
```
